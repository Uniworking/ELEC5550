## sdkconfig.defaults
```kconfig
CONFIG_TINYUSB_ENABLED=y
CONFIG_TINYUSB_USBDEVICE_ENABLED=y
CONFIG_TINYUSB_HID_ENABLED=y
CONFIG_USB_DEVICE_VPORT_IN_ISR=y
CONFIG_USB_DEVICE_HID_KEYBOARD=y
CONFIG_ESP32S3_USB_OTG_SUPPORTED=y
```
